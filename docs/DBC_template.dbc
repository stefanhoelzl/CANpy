VERSION "1.0"

NS_ :

BS_:

BU_: Node2 Node1 Node0
VAL_TABLE_ Value0 2 "Value2" 1 "Value1" 0 "Value0" ;
VAL_TABLE_ Numbers 3 "Three" 2 "Two" 1 "One" 0 "Zero" ;

BO_ 2147487969 CANMultiplexed: 2 Node0
 SG_ Value1 m1 : 8|8@1+ (1,0) [0|0] ""  Node1
 SG_ Value0 m0 : 8|8@1+ (1,0) [0|0] ""  Node0
 SG_ Multiplexer M : 0|8@1+ (1,0) [0|0] ""  Node0

BO_ 1234 CANMessage: 8 Node0
 SG_ Signal1 : 32|32@1+ (100,0) [0|100] "%"  Node1,Node2
 SG_ Signal0 : 0|32@1- (1,0) [0|0] ""  Node1,Node2
